## board/mt6582/Kconfig
```kconfig
if MT6582_S3030

config SYS_BOARD
       default "mt6582_s3030"

config SYS_VENDOR
       default "own"

config SYS_CONFIG_NAME
       default "mt6582_s3030"

config SYS_TEXT_BASE
	default 0x87800000

endif
```

## configs/mt6582_s3030_defconfig
```kconfig
CONFIG_CFB_CONSOLE=y
CONFIG_CMD_BOOTM=y
CONFIG_SPLASH_SCREEN=n
CONFIG_VIDEO_LOGO=n
CONFIG_ARMV7_VIRT=y 
```

## configs/mx6ull_prime_defconfig
```kconfig
CONFIG_SYS_EXTRA_OPTIONS="IMX_CONFIG=board/hp/mx6ull_prime/imximage.cfg"
CONFIG_ARM=y
CONFIG_ARCH_MX6=y
CONFIG_TARGET_MX6ULL_PRIME=y
CONFIG_VIDEO=y
CONFIG_DEFAULT_DEVICE_TREE="imx6ull-prime"
CONFIG_DEFAULT_FDT_FILE="imx6ull-prime.dtb"
CONFIG_BOOTDELAY=2
# CONFIG_CONSOLE_MUX is not set
CONFIG_SYS_CONSOLE_IS_IN_ENV=y
CONFIG_BOARD_EARLY_INIT_F=y
CONFIG_HUSH_PARSER=y
CONFIG_CMD_BOOTZ=y
# CONFIG_CMD_IMLS is not set
CONFIG_CMD_MEMTEST=y
CONFIG_CMD_USB=n
CONFIG_CMD_I2C=y
CONFIG_CMD_GPIO=y
CONFIG_CMD_BMP=y
CONFIG_CMD_CACHE=y
CONFIG_CMD_EXT2=n
CONFIG_CMD_EXT4=n
CONFIG_CMD_EXT4_WRITE=n
CONFIG_CMD_FAT=n
CONFIG_CMD_FS_GENERIC=n
CONFIG_OF_CONTROL=y
CONFIG_DM_GPIO=y
CONFIG_DM_I2C=y
CONFIG_PINCTRL=y
CONFIG_PINCTRL_IMX6=y
CONFIG_USB=n
CONFIG_DM_USB=n
CONFIG_USB_HOST_ETHER=n
CONFIG_USB_ETHER_ASIX=n
CONFIG_USB_STORAGE=n
CONFIG_DM_ETH=n
CONFIG_NAND_BOOT=y
CONFIG_CMD_BOOTEFI=y
CONFIG_EFI_LOADER=y
CONFIG_CFB_CONSOLE=y
CONFIG_CMD_BOOTM=y
CONFIG_SPLASH_SCREEN=n
CONFIG_VIDEO_LOGO=n
CONFIG_ARMV7_VIRT=y
```
